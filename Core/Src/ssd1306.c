
#include <stdint.h>
#include "ssd1306.h"

#define IIC_SCK_PIN 5
#define IIC_SDA_PIN 6

#define OLED_COLUMN_NUMBER 128
#define OLED_LINE_NUMBER 64
#define OLED_PAGE_NUMBER (OLED_LINE_NUMBER/8)
#define OLED_COLUMN_OFFSET 0
#define OLED_LINE_OFFSET 0
#define OLED_CMD_NUMBER 25
/**********SPI引脚分配，连接oled屏，更具实际情况修改*********/

#define IIC_SCK_0  GPIOB->BRR=0X0040       // 设置sck接口到PB5   清零
#define IIC_SCK_1  GPIOB->BSRR=0X0040       //置位
#define IIC_SDA_0  GPIOB->BRR=0X0080       // 设置SDA接口到PB6
#define IIC_SDA_1  GPIOB->BSRR=0X0080
#define READ_SDA     (GPIOB->IDR & 0X0040)
const unsigned char *point;
unsigned char ACK = 0;
static SSD1306_t SSD1306;
// Screenbuffer
static uint8_t SSD1306_Buffer[SSD1306_BUFFER_SIZE];
const unsigned char OLED_init_cmd[OLED_CMD_NUMBER] =
    {

        0xAE,//关闭显示

        0xD5,//设置时钟分频因子,震荡频率
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        0xAF,//开启显示
    };

const unsigned char picture_tab[] = {
//图片显示，列行式，低位在前，阴码
    0xFF, 0x01, 0x01, 0x01, 0x01, 0x01, 0x01, 0x01, 0x01, 0x01, 0x01, 0x01, 0x01, 0x01, 0x01, 0x01,
    0x01, 0x01, 0x01, 0x01, 0x01, 0x01, 0x01, 0x01, 0x01, 0x01, 0x01, 0x01, 0x01, 0x01, 0x01, 0x01,
    0x01, 0x01, 0x01, 0x01, 0x01, 0x01, 0x01, 0x01, 0x01, 0x01, 0x01, 0x01, 0x01, 0x01, 0x01, 0x01,
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    0x80, 0x80, 0x80, 0x80, 0x80, 0x80, 0x80, 0x80, 0x80, 0x80, 0x80, 0x80, 0x80, 0x80, 0x80, 0xFF

};

void delay_us(uint32_t us)
{
    uint32_t count = us * 9;  // 72M主频下大约9个指令周期是1微秒
    while (count--) {
        __asm("nop");  // 每个 NOP 指令大约消耗1个指令周期
    }
}

void delay_ms(unsigned int _ms_time)
{
    HAL_Delay(_ms_time);
}

/**************************IIC模块发送函数************************************************

 *************************************************************************/
//写入  最后将SDA拉高，以等待从设备产生应答
void IIC_write(unsigned char date)
{
    unsigned char i, temp;
    temp = date;

    for (i = 0; i < 8; i++) {
        IIC_SCK_0;

        if ((temp & 0x80) == 0)
            IIC_SDA_0;
        else
            IIC_SDA_1;
        temp = temp << 1;
        delay_us(1);
        IIC_SCK_1;
        delay_us(1);

    }
    IIC_SCK_0;
    delay_us(1);
    IIC_SDA_1;
    delay_us(1);
    IIC_SCK_1;
//								不需要应答
//	if (READ_SDA==0)
//		ACK = 1;
//	else ACK =0;
    delay_us(1);
    IIC_SCK_0;
    delay_us(1);


}

//启动信号
//SCL在高电平期间，SDA由高电平向低电平的变化定义为启动信号
void IIC_start()
{
    IIC_SDA_1;
    delay_us(1);
    IIC_SCK_1;
    delay_us(1);                   //所有操作结束释放SCL
    IIC_SDA_0;
    delay_us(3);
    IIC_SCK_0;

    IIC_write(0x78);

}

//停止信号
//SCL在高电平期间，SDA由低电平向高电平的变化定义为停止信号
void IIC_stop()
{
    IIC_SDA_0;
    delay_us(1);
    IIC_SCK_1;
    delay_us(3);
    IIC_SDA_1;

}

void OLED_send_cmd(unsigned char o_command)
{

    IIC_start();
    IIC_write(0x00);
    IIC_write(o_command);
    IIC_stop();

}

void OLED_send_data(unsigned char o_data)
{
    IIC_start();
    IIC_write(0x40);
    IIC_write(o_data);
    IIC_stop();
}

void Column_set(unsigned char column)
{
    column = column + OLED_COLUMN_OFFSET;
    OLED_send_cmd(0x10 | (column >> 4));    //设置列地址高位
    OLED_send_cmd(0x00 | (column & 0x0f));   //设置列地址低位

}

void Page_set(unsigned char page)
{
    page = page + (OLED_LINE_OFFSET / 8);
    OLED_send_cmd(0xb0 + page);
}

void OLED_clear(void)
{
    unsigned char page, column;
    for (page = 0; page < OLED_PAGE_NUMBER; page++)             //page loop
    {
        Page_set(page);
        Column_set(0);
        for (column = 0; column < OLED_COLUMN_NUMBER; column++)    //column loop
        {
            OLED_send_data(0x00);
        }
    }
}

void OLED_full(void)
{
    unsigned char page, column;
    for (page = 0; page < OLED_PAGE_NUMBER; page++)             //page loop
    {
        Page_set(page);
        Column_set(0);
        for (column = 0; column < OLED_COLUMN_NUMBER; column++)    //column loop
        {
            OLED_send_data(0x00);
        }
    }
}

void OLED_init(void)
{
    unsigned char i;
    for (i = 0; i < OLED_CMD_NUMBER; i++) {
        OLED_send_cmd(OLED_init_cmd[i]);
    }
}

__attribute__((unused)) void Picture_display(const unsigned char *ptr_pic)
{
    unsigned char page, column;
    for (page = 0; page < OLED_PAGE_NUMBER; page++)        //page loop
    {
        Page_set(page);
        Column_set(0);
        for (column = 0; column < OLED_COLUMN_NUMBER; column++)    //column loop
        {
            OLED_send_data(*ptr_pic++);
        }
    }
}

__attribute__((unused)) void Picture_ReverseDisplay(const unsigned char *ptr_pic)
{
    unsigned char page, column, data;
    for (page = 0; page < OLED_PAGE_NUMBER; page++)        //page loop
    {
        Page_set(page);
        Column_set(0);
        for (column = 0; column < OLED_COLUMN_NUMBER; column++)    //column loop
        {
            data = *ptr_pic++;
            data = ~data;
            OLED_send_data(data);
        }
    }
}
char ssd1306_WriteString(char* str, SSD1306_Font_t Font, SSD1306_COLOR color) {
    while (*str) {
        if (ssd1306_WriteChar(*str, Font, color) != *str) {
            // Char could not be written
            return *str;
        }
        str++;
    }

    // Everything ok
    return *str;
}
/*
 * Draw 1 char to the screen buffer
 * ch       => char om weg te schrijven
 * Font     => Font waarmee we gaan schrijven
 * color    => Black or White
 */
char ssd1306_WriteChar(char ch, SSD1306_Font_t Font, SSD1306_COLOR color) {
    uint32_t i, b, j;

    // Check if character is valid
    if (ch < 32 || ch > 126)
        return 0;

    // Check remaining space on current line
    if (SSD1306_WIDTH < (SSD1306.CurrentX + Font.width) ||
        SSD1306_HEIGHT < (SSD1306.CurrentY + Font.height))
    {
        // Not enough space on current line
        return 0;
    }

    // Use the font to write
    for(i = 0; i < Font.height; i++) {
        b = Font.data[(ch - 32) * Font.height + i];
        for(j = 0; j < Font.width; j++) {
            if((b << j) & 0x8000)  {
                ssd1306_DrawPixel(SSD1306.CurrentX + j, (SSD1306.CurrentY + i), (SSD1306_COLOR) color);
            } else {
                ssd1306_DrawPixel(SSD1306.CurrentX + j, (SSD1306.CurrentY + i), (SSD1306_COLOR)!color);
            }
        }
    }

    // The current space is now taken
    SSD1306.CurrentX += Font.char_width ? Font.char_width[ch - 32] : Font.width;

    // Return written char for validation
    return ch;
}
void ssd1306_DrawPixel(uint8_t x, uint8_t y, SSD1306_COLOR color) {
    if(x >= SSD1306_WIDTH || y >= SSD1306_HEIGHT) {
        // Don't write outside the buffer
        return;
    }

    // Draw in the right color
    if(color == White) {
        SSD1306_Buffer[x + (y / 8) * SSD1306_WIDTH] |= 1 << (y % 8);
    } else {
        SSD1306_Buffer[x + (y / 8) * SSD1306_WIDTH] &= ~(1 << (y % 8));
    }
}

void ssd1306_SetCursor(uint8_t x, uint8_t y) {
    SSD1306.CurrentX = x;
    SSD1306.CurrentY = y;
}

void ssd1306_UpdateScreen(void)
{
    // Write data to each page of RAM. Number of pages
    // depends on the screen height:
    //
    //  * 32px   ==  4 pages
    //  * 64px   ==  8 pages
    //  * 128px  ==  16 pages
    for(uint8_t i = 0; i < SSD1306_HEIGHT/8; i++) {
        OLED_send_cmd(0xB0 + i); // Set the current RAM page address.
        OLED_send_cmd(0x00 + SSD1306_X_OFFSET_LOWER);
        OLED_send_cmd(0x10 + SSD1306_X_OFFSET_UPPER);
        for (int j = 0; j < SSD1306_WIDTH; ++j) {
            OLED_send_data(SSD1306_Buffer[SSD1306_WIDTH*i+j]);

        }
    }
}

/* Draw circle by Bresenhem's algorithm */
void ssd1306_DrawCircle(uint8_t par_x,uint8_t par_y,uint8_t par_r,SSD1306_COLOR par_color) {
    int32_t x = -par_r;
    int32_t y = 0;
    int32_t err = 2 - 2 * par_r;
    int32_t e2;

    if (par_x >= SSD1306_WIDTH || par_y >= SSD1306_HEIGHT) {
        return;
    }

    do {
        ssd1306_DrawPixel(par_x - x, par_y + y, par_color);
        ssd1306_DrawPixel(par_x + x, par_y + y, par_color);
        ssd1306_DrawPixel(par_x + x, par_y - y, par_color);
        ssd1306_DrawPixel(par_x - x, par_y - y, par_color);
        e2 = err;

        if (e2 <= y) {
            y++;
            err = err + (y * 2 + 1);
            if(-x == y && e2 <= x) {
                e2 = 0;
            }
        }

        if (e2 > x) {
            x++;
            err = err + (x * 2 + 1);
        }
    } while (x <= 0);

    return;
}
/* Draw filled circle. Pixel positions calculated using Bresenham's algorithm */
void ssd1306_FillCircle(uint8_t par_x,uint8_t par_y,uint8_t par_r,SSD1306_COLOR par_color) {
    int32_t x = -par_r;
    int32_t y = 0;
    int32_t err = 2 - 2 * par_r;
    int32_t e2;

    if (par_x >= SSD1306_WIDTH || par_y >= SSD1306_HEIGHT) {
        return;
    }

    do {
        for (uint8_t _y = (par_y + y); _y >= (par_y - y); _y--) {
            for (uint8_t _x = (par_x - x); _x >= (par_x + x); _x--) {
                ssd1306_DrawPixel(_x, _y, par_color);
            }
        }

        e2 = err;
        if (e2 <= y) {
            y++;
            err = err + (y * 2 + 1);
            if (-x == y && e2 <= x) {
                e2 = 0;
            }
        }

        if (e2 > x) {
            x++;
            err = err + (x * 2 + 1);
        }
    } while (x <= 0);

    return;
}
//初始化显示所有中文
void oled_ShownChinese(char x,char y,char *p){
    //电压
    OLED_send_cmd(0x20); // Set the current RAM page address.
    OLED_send_cmd(0x00);
    OLED_send_cmd(0x21);
    OLED_send_cmd(x);
    OLED_send_cmd(x+0x0f);
    OLED_send_cmd(0x22);
    OLED_send_cmd(y);
    OLED_send_cmd(y+0x01);
    for (int i = 0; i < 31; ++i) {
        OLED_send_data(p[i]);
    }

//
//    for (int i = 2; i < 4; ++i) {
//        for (int j = 0; j < 16; ++j) {
//            OLED_send_data(Chinese_word[i][j]);
//        }
//    }
//    OLED_send_cmd(0xB0 + 1); // Set the current RAM page address.
//    OLED_send_cmd(0x00 + SSD1306_X_OFFSET_LOWER);
//    OLED_send_cmd(0x10 + SSD1306_X_OFFSET_UPPER);
//    for (int i = 2; i < 4; ++i) {
//        for (int j = 16; j < 32; ++j) {
//            OLED_send_data(Chinese_word[i][j]);
//        }
//    }
//        //阈值：
//        OLED_send_cmd(0xB0 + 2); // Set the current RAM page address.
//        OLED_send_cmd(0x00 + SSD1306_X_OFFSET_LOWER);
//        OLED_send_cmd(0x10 + SSD1306_X_OFFSET_UPPER);
//        for (int i = 0; i < 2; ++i) {
//            for (int j = 0; j < 16; ++j) {
//                OLED_send_data(Chinese_word[i][j]);
//            }
//        }
//        OLED_send_cmd(0xB0+3); // Set the current RAM page address.
//        OLED_send_cmd(0x00 + SSD1306_X_OFFSET_LOWER);
//        OLED_send_cmd(0x10 + SSD1306_X_OFFSET_UPPER);
//        for (int i = 0; i < 2; ++i) {
//            for (int j = 16; j < 32; ++j) {
//                OLED_send_data(Chinese_word[i][j]);
//        }
//    }
//
//
//
//    //测量范围：
//        OLED_send_cmd(0xB0+4); // Set the current RAM page address.
//        OLED_send_cmd(0x00 + SSD1306_X_OFFSET_LOWER);
//        OLED_send_cmd(0x10 + SSD1306_X_OFFSET_UPPER);
//        for (int i = 4; i < 6; ++i) {
//            for (int j = 0; j < 16; ++j) {
//                    OLED_send_data(Chinese_word[i][j]);
//            };
//        }
//    //测量范围：
//        OLED_send_cmd(0xB0+5); // Set the current RAM page address.
//        OLED_send_cmd(0x00 + SSD1306_X_OFFSET_LOWER);
//        OLED_send_cmd(0x10 + SSD1306_X_OFFSET_UPPER);
//        for (int i = 4; i < 6; ++i) {
//            for (int j = 16; j < 32; ++j) {
//                OLED_send_data(Chinese_word[i][j]);
//        };
//    }
}
void oled_write_string(char x, char y, char *p, uint8_t len)
{

    uint8_t str_x = x;
    for(uint8_t i = 0; i < len; i++)
    {

        uint8_t place = p[i];
        oled_write_str(str_x, y, place);
        str_x = str_x + 0x08;

    }

}
void oled_write_str(char x, char y, uint8_t chr)         //
{

    chr = chr - ' ';
    OLED_send_cmd(0x20);
    OLED_send_cmd(0x00);
    OLED_send_cmd(0x21);
    OLED_send_cmd(x);
    OLED_send_cmd(x+0x07);
    OLED_send_cmd(0x22);
    OLED_send_cmd(y);
    OLED_send_cmd(y+0x01);

    for(int i = 0; i < 16; i++)
    {

        OLED_send_data(asc2_1608[chr][i]);

    }

}
void oled_write_str_Over(char x, char y, uint8_t chr)         //
{

    chr = chr - ' ';
    OLED_send_cmd(0x20);
    OLED_send_cmd(0x00);
    OLED_send_cmd(0x21);
    OLED_send_cmd(x);
    OLED_send_cmd(x+0x07);
    OLED_send_cmd(0x22);
    OLED_send_cmd(y);
    OLED_send_cmd(y+0x01);

    for(int i = 0; i < 16; i++)
    {

        OLED_send_data(0xff-asc2_1608[chr][i]);

    }

}
void oled_write_string_Over(char x, char y, char *p, uint8_t len)
{

    uint8_t str_x = x;
    for(uint8_t i = 0; i < len; i++)
    {

        uint8_t place = p[i];
        oled_write_str_Over(str_x, y, place);
        str_x = str_x + 0x08;

    }

}